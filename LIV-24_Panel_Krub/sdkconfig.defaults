## LIV-24_Panel_Krub/sdkconfig.defaults
```kconfig
CONFIG_ESP32P4_SELECTS_REV_LESS_V3=y
CONFIG_ESP32P4_REV_MIN_0=y

# Flash
CONFIG_ESPTOOLPY_FLASHSIZE_4MB=y
CONFIG_ESPTOOLPY_FLASHSIZE="4MB"
CONFIG_ESPTOOLPY_FLASHMODE_DIO=y
CONFIG_ESPTOOLPY_FLASHMODE="dio"
CONFIG_ESPTOOLPY_FLASHFREQ_40M=y
CONFIG_ESPTOOLPY_FLASHFREQ="40m"
CONFIG_ESPTOOLPY_FLASH_SAMPLE_MODE_STR=y

# PSRAM - MIPI DSI frame buffer requires HEX mode
CONFIG_SPIRAM=y
CONFIG_SPIRAM_MODE_HEX=y
CONFIG_SPIRAM_SPEED_200M=y

# LVGL fonts
CONFIG_LV_FONT_MONTSERRAT_14=y
CONFIG_LV_FONT_MONTSERRAT_24=y
CONFIG_LV_FONT_MONTSERRAT_32=y
CONFIG_LV_FONT_MONTSERRAT_48=y

# LVGL heap
CONFIG_LV_MEM_SIZE_KILOBYTES=128
CONFIG_LV_MEM_POOL_EXPAND_SIZE_KILOBYTES=256

# Main task stack
CONFIG_ESP_MAIN_TASK_STACK_SIZE=8192

# WDT timeout
CONFIG_ESP_TASK_WDT_TIMEOUT_S=5
```
